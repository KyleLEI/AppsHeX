## examples/hello3300/Kconfig
```kconfig
#
# For a description of the syntax of this configuration file,
# see the file kconfig-language.txt in the NuttX tools repository.
#

config EXAMPLES_HELLO3300
	bool "\"Hello, 3300!\" example"
	default n
	---help---
		Enable the \"Hello, 3300!\" example

if EXAMPLES_HELLO3300

config EXAMPLES_HELLO3300_PROGNAME
	string "Program name"
	default "hello3300"
	depends on BUILD_KERNEL && CONFIG_NETUTILS_ESP8266
	---help---
		This is the name of the program that will be use when the NSH ELF
		program is installed.

config EXAMPLES_HELLO3300_PRIORITY
	int "Hello task priority"
	default 100

config EXAMPLES_HELLO3300_STACKSIZE
	int "Hello stack size"
	default 2048

endif
```

## examples/ledc/Kconfig
```kconfig
#
# For a description of the syntax of this configuration file,
# see the file kconfig-language.txt in the NuttX tools repository.
#

config EXAMPLES_LEDC
	bool "LED controller example"
	default n
	depends on ARCH_HAVE_LEDS && !ARCH_LEDS
	---help---
		Enable the LED controllerexample

if EXAMPLES_LEDC

config EXAMPLES_LEDC_PROGNAME
	string "Program name"
	default "ledc"
	depends on BUILD_KERNEL
	---help---
		This is the name of the program that will be use when the NSH ELF
		program is installed.

config EXAMPLES_LEDC_PRIORITY
	int "LED task priority"
	default 100

config EXAMPLES_LEDC_STACKSIZE
	int "LED stack size"
	default 2048

config EXAMPLES_LEDC_DEVPATH
	string "LED device path"
	default "/dev/userleds"

config EXAMPLES_LEDLCLEDSET
	hex "Subset of LEDs to use"
	default 0x0f

endif # EXAMPLES_LEDC
```

## examples/mpu6050/Kconfig
```kconfig
#
# For a description of the syntax of this configuration file,
# see the file kconfig-language.txt in the NuttX tools repository.
#

config EXAMPLES_MPU6050
	bool "MPU-6050 Test Application"
	default n
	depends on SENSORS_MPU6050
	---help---
		Enable the MPU-6050 test application.

if EXAMPLES_MPU6050

config EXAMPLES_MPU6050_PROGNAME
	string "MPU6050 Test Program name"
	default "mpu6050"
	depends on BUILD_KERNEL
	---help---
		This is the name of the program that will be use when the NSH ELF
		program is installed.

config EXAMPLES_MPU6050_DEVNAME
	string "MPU-6050 device file name"
	default "/dev/mpu6050"
	---help---
		This is the name of device file name created by MPU6050 driver.

config EXAMPLES_MPU6050_PRIORITY
	int "MPU-6050 Test task priority"
	default 100

config EXAMPLES_MPU6050_STACKSIZE
	int "MPU-6050 Test stack size"
	default 2048

endif
```

## examples/smarthome_base/Kconfig
```kconfig
#
# For a description of the syntax of this configuration file,
# see the file kconfig-language.txt in the NuttX tools repository.
#

config EXAMPLES_SMARTHOME_BASE
	bool "Smarthome base module"
	default n
	---help---
		Enable the smarthome base module example

if EXAMPLES_SMARTHOME_BASE

config EXAMPLES_SMARTHOME_BASE_PROGNAME
	string "Program name"
	default "smarthome_base"
	depends on BUILD_KERNEL && CONFIG_NETUTILS_ESP8266
	---help---
		This is the name of the program that will be use when the NSH ELF
		program is installed.

config EXAMPLES_SMARTHOME_BASE_PRIORITY
	int "Base module task priority"
	default 100

config EXAMPLES_SMARTHOME_BASE_STACKSIZE
	int "Base module stack size"
	default 2048

endif
```

## examples/smarthome_remote/Kconfig
```kconfig
#
# For a description of the syntax of this configuration file,
# see the file kconfig-language.txt in the NuttX tools repository.
#

config EXAMPLES_SMARTHOME_REMOTE
	bool "Smarthome remote module"
	default n
	---help---
		Enable the smarthome remote module example

if EXAMPLES_SMARTHOME_REMOTE

config EXAMPLES_SMARTHOME_ROMOTE_PROGNAME
	string "Program name"
	default "smarthome_remote"
	depends on BUILD_KERNEL && CONFIG_NETUTILS_ESP8266
	---help---
		This is the name of the program that will be use when the NSH ELF
		program is installed.

config EXAMPLES_SMARTHOME_REMOTE_PRIORITY
	int "Remote module task priority"
	default 100

config EXAMPLES_SMARTHOME_REMOTE_STACKSIZE
	int "Remote module stack size"
	default 2048

endif
```

## examples/ssd1306_seg/Kconfig
```kconfig
#
# For a description of the syntax of this configuration file,
# see the file kconfig-language.txt in the NuttX tools repository.
#

config EXAMPLES_SSD1306_SEG
	bool "SSD1306 alphanumeric driver example"
	default n
	depends on LCD_SSD1306_SEG
	---help---
		Enable the SSD1306 alphanumeric driver example

if EXAMPLES_SSD1306_SEG

config EXAMPLES_EXAMPLES_SSD1306_SEG_PROGNAME
	string "Program name"
	default "ssd1306_seg"
	depends on BUILD_KERNEL
	---help---
		This is the name of the program that will be use when the NSH ELF
		program is installed.

config EXAMPLES_SSD1306_SEG_DEVNAME
	string "SSD1306 alphanumeric device file name"
	default "/dev/slcd0"
	---help---
		This is the name of device file name created by SSD1306 alphanumeric driver.
		
config EXAMPLES_EXAMPLES_SSD1306_SEG_PRIORITY
	int "SSD1306 example task priority"
	default 100

config EXAMPLES_EXAMPLES_SSD1306_SEG_STACKSIZE
	int "SSD1306 example stack size"
	default 2048

endif
```
